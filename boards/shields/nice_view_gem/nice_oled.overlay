/*
 * Copyright (c) 2022 The ZMK Contributors
 *
 * SPDX-License-Identifier: MIT
 */

&nice_oled_spi {
    status = "okay";
    nice_oled: ls0xx@0 {
        compatible = "sharp,ls0xx";
        spi-max-frequency = <1000000>;
        reg = <0>;
        width = <160>;
        height = <68>;
    };
};

/ {
    chosen {
        zephyr,display = &nice_oled;
    };
};
